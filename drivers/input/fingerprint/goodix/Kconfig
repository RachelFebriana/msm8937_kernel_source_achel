## drivers/input/fingerprint/goodix/Kconfig
```kconfig
config FINGERPRINT_GOODIX_GF3208
	bool "Goodix GF3208 fingerprint drvier support"
	depends on FINGERPRINT
	help
	  Say Y here to enable goodix fingerprint driver support!
```

## techpack/xiaomi-msm8937/power_supply/bq2560x/Kconfig
```kconfig
config CHARGER_BQ2560X_MI8937
	tristate "TI BQ2560X battery charger driver"
	depends on I2C
	help
	  Say Y to enable support for TI bq2560X charger
```
